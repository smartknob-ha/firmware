## components/smartknob_config/Kconfig
```kconfig
menu "Smartknob Config"
    rsource "../ring_lights/config"
    rsource "../light_sensor/config"
    rsource "../display_driver/config"
    rsource "../magnetic_encoder/config"
    rsource "../strain_sensor/config"
    rsource "../filesystem/config"
endmenu
```

## sdkconfig.defaults
```kconfig
CONFIG_APP_RETRIEVE_LEN_ELF_SHA=16
CONFIG_ESPTOOLPY_FLASHSIZE_16MB=y
CONFIG_PARTITION_TABLE_CUSTOM=y
CONFIG_COMPILER_CXX_EXCEPTIONS=y
CONFIG_COMPILER_CXX_RTTI=y
CONFIG_COMPILER_STACK_CHECK_MODE_NORM=y
CONFIG_SPI_MASTER_IN_IRAM=y
CONFIG_LEDC_CTRL_FUNC_IN_IRAM=y
CONFIG_ESP_HTTP_CLIENT_ENABLE_DIGEST_AUTH=y
CONFIG_ESP_HTTPS_OTA_ALLOW_HTTP=y
CONFIG_GDMA_CTRL_FUNC_IN_IRAM=y
CONFIG_GDMA_ISR_IRAM_SAFE=y
CONFIG_ESP_PHY_REDUCE_TX_POWER=y
CONFIG_SPIRAM=y
CONFIG_SPIRAM_MODE_OCT=y
CONFIG_SPIRAM_FETCH_INSTRUCTIONS=y
CONFIG_SPIRAM_RODATA=y
CONFIG_SPIRAM_SPEED_80M=y
CONFIG_SPIRAM_ALLOW_BSS_SEG_EXTERNAL_MEMORY=y
CONFIG_ESP_DEFAULT_CPU_FREQ_MHZ_240=y
CONFIG_ESP_MAIN_TASK_STACK_SIZE=16384
CONFIG_ESP_IPC_TASK_STACK_SIZE=1536
CONFIG_FREERTOS_HZ=1000
CONFIG_LOG_MAXIMUM_LEVEL_DEBUG=y
CONFIG_LWIP_SO_RCVBUF=y
CONFIG_LWIP_TCP_SND_BUF_DEFAULT=5744
CONFIG_LWIP_TCP_WND_DEFAULT=5744
CONFIG_MBEDTLS_ECP_RESTARTABLE=y
CONFIG_PTHREAD_DEFAULT_CORE_0=y
CONFIG_UNITY_ENABLE_COLOR=y
CONFIG_UNITY_ENABLE_BACKTRACE_ON_FAIL=y
CONFIG_WIFI_PROV_BLE_FORCE_ENCRYPTION=y
CONFIG_NUM_COMPONENTS=10
CONFIG_RUN_TASK_STACK_SIZE=8192
CONFIG_STRAIN_SENSOR_NUM_CALIBRATION_MEASUREMENTS=1000
```
